/*
 * user.c
 *
 *  Created on: 2021/03/15
 *      Author: KIU-CHI
 */
#include "main.h"
#include "usbd_cdc_if.h"
#include "user.h"
#include <stdlib.h>
#include <string.h>

uint16_t anode_buf[22][24] = {};
uint16_t anode_data[22][24] = {};
uint16_t tx_data[24] = {};
uint16_t mask1 = 0xAAAA;
uint16_t mask2 = 0x5555;
uint16_t grid_buf[3] = {};
uint8_t rx_data[1024] = { 0xff, 0xff, 0xff, 0xff, 0xff, 0xff, 0xff, 0xff, 0xff,
		0xff, 0xff, 0xff, 0xff, 0xff, 0xff, 0xff, 0xff, 0xff, 0xff, 0xff, 0xff,
		0xff, 0xff, 0xff, 0xff, 0xff, 0xff, 0xff, 0xff, 0xff, 0xff, 0xff, 0xff,
		0xff, 0xff, 0xff, 0xff, 0xff, 0xff, 0xff, 0xff, 0xff, 0xff, 0xff, 0xff,
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		0xff, 0xff, 0xff, 0xff, 0xff, };

void init() {
	LL_TIM_EnableAllOutputs(TIM1);
	LL_TIM_CC_EnableChannel(TIM1, LL_TIM_CHANNEL_CH1);
	LL_TIM_CC_EnableChannel(TIM1, LL_TIM_CHANNEL_CH2);
	LL_TIM_EnableIT_CC2(TIM1);
	LL_TIM_EnableCounter(TIM1);

	loop();
}

void decode_data() {
	LL_GPIO_TogglePin(GPIOC, LL_GPIO_PIN_13);
	if (LL_GPIO_IsInputPinSet(GPIOB, LL_GPIO_PIN_5)) {
		for (int x = 0; x < 128; x++) {
			uint8_t vline[8];
			for (int i = 0; i < 8; i++) {
				vline[i] = rx_data[i * 128 + x];
			}
			uint8_t t = x / 6;
			uint8_t grid = x % 6;
			uint8_t shift;
			if (grid <= 2)
				shift = grid * 2;
			else
				shift = (5 - grid) * 2 + 1;

			if (grid == 0) {
				for (int i = 0; i < 24; i++) {
					anode_buf[t][i] = 0;
				}
			}

			for (int i = 0; i < 64; i++) {
				uint16_t bit = (vline[i / 8] & (0x80 >> (i % 8)))>> (7 - i % 8);
				anode_buf[t][(i * 6 + shift) / 16] |= bit<< (15 - (i * 6 + shift) % 16);
			}
		}
	}
	for(int g=0; g<22; g++){
		for(int a=0; a<24; a++){
			anode_data[g][a] = anode_buf[g][a];
		}
	}
	//LL_GPIO_TogglePin(GPIOC, LL_GPIO_PIN_13);
}

void scan_start(){
	static uint8_t grid_now = 0;
	static uint8_t grid_next = 1;


	uint16_t mask;
	if((grid_now+1) % 2) mask = mask1;
	else mask = mask2;
	for(int i=0; i<24; i++){
		tx_data[i] = anode_data[grid_now>>1][i] & mask;
		//tx_data[i] = anode_buf[grid_now>>1][i];
	}
	HAL_SPI_Transmit_DMA(&hspi1, tx_data, 24);


	//HAL_SPI_Transmit_DMA(&hspi1, anode_buf[grid_now>>1], 24);

	for(int i=0; i<3; i++){
		grid_buf[i] = 0x0000;
	}
	grid_buf[grid_now / 16] = 0x8000 >> grid_now % 16;
	grid_buf[grid_next / 16] |= (0x8000 >> grid_next % 16);

	grid_now = grid_next;
	grid_next++;
	if(grid_next > 43){
		grid_next = 1;
		grid_now = 0;
		//LL_GPIO_TogglePin(GPIOC, LL_GPIO_PIN_13);
	}

	HAL_SPI_Transmit_DMA(&hspi2, grid_buf, 3);
}

void loop() {
	decode_data();
	while (1) {

	}
}

void usb_rx_callback(uint8_t * rx_buf, uint16_t * len){

	if(*len >= 1024){
		for(int i=0; i<1024; i++){
			rx_data[i] = rx_buf[i];
		}
		*len = 0;
		decode_data();
	}else if(*len == 4){
		*len = 0;
	}
}
